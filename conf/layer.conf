## conf/layer.conf
```bitbake
# We have a conf and classes directory, add to BBPATH
BBPATH .= ":${LAYERDIR}"

# We have recipes-* directories, add to BBFILES
BBFILES += "${LAYERDIR}/recipes-*/*/*.bb \
            ${LAYERDIR}/recipes-*/*/*.bbappend"

BBFILE_COLLECTIONS += "meta-my_test"
BBFILE_PATTERN_meta-my_test = "^${LAYERDIR}/"
BBFILE_PRIORITY_meta-my_test = "6"

LAYERDEPENDS_meta-my_test = "core"
LAYERSERIES_COMPAT_meta-my_test = "walnascar"
```
